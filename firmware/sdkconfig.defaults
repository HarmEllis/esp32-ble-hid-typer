## firmware/sdkconfig.defaults
```kconfig
# Partition table
CONFIG_PARTITION_TABLE_CUSTOM=y
CONFIG_PARTITION_TABLE_CUSTOM_FILENAME="partitions.csv"

# Flash size (8 MB, common for S3 DevKit boards)
CONFIG_ESPTOOLPY_FLASHSIZE_8MB=y

# Bluetooth — use NimBLE, not Bluedroid
CONFIG_BT_ENABLED=y
CONFIG_BT_NIMBLE_ENABLED=y

# NimBLE tuning
CONFIG_BT_NIMBLE_SM_SC=y
CONFIG_BT_NIMBLE_SM_SC_DEBUG_KEYS=n
CONFIG_BT_NIMBLE_MAX_BONDS=1
CONFIG_BT_NIMBLE_MAX_CONNECTIONS=1
CONFIG_BT_NIMBLE_EXT_ADV=n

# NimBLE security — reject legacy pairing
CONFIG_BT_NIMBLE_SM_LEGACY=n

# TinyUSB
CONFIG_TINYUSB_HID_COUNT=1
```

## firmware/sdkconfig.defaults.esp32s3
```kconfig
# ESP32-S3 specific overrides
CONFIG_IDF_TARGET="esp32s3"
CONFIG_BT_BLE_42_FEATURES_SUPPORTED=y
```
